## firmware/gateway/main/Kconfig.projbuild
```kconfig
menu "Vehicle diagnostics gateway"

    choice GATEWAY_TARGET
        prompt "Target"
        default GATEWAY_TARGET_VEHICLE
        help
            What the gateway is connected to. A vehicle build stops all requests and keeps
            only listening as soon as the bus shows errors or the controller goes bus-off, and
            does not recover automatically. A bench build recovers and resumes.

        config GATEWAY_TARGET_BENCH
            bool "Bench: the simulated ECU on the desk"
        config GATEWAY_TARGET_VEHICLE
            bool "Vehicle: a real car's OBD-II port"
    endchoice

    config GATEWAY_LISTEN_ONLY
        bool "Listen only: transmit and acknowledge nothing"
        default y
        help
            The safe first contact with a vehicle. The controller neither sends frames nor
            acknowledges them, and the gateway reports which identifiers it observes and the
            bus error count. Turn this off only once the bit rate is known to be right.

    choice GATEWAY_CAN_BITRATE
        prompt "CAN bit rate"
        default GATEWAY_CAN_BITRATE_500
        help
            ISO 15765-4 allows 250 and 500 kbps on the OBD-II port. Check the vehicle's
            protocol with an ELM327 (ATDP) before building for it.

        config GATEWAY_CAN_BITRATE_500
            bool "500 kbps"
        config GATEWAY_CAN_BITRATE_250
            bool "250 kbps"
    endchoice

    config GATEWAY_FUNCTIONAL_ADDRESSING
        bool "Request on 0x7DF (functional) instead of 0x7E0 (physical)"
        default n
        help
            For engine ECUs that do not answer physically addressed requests. Answers are
            still taken only from 0x7E8.

    config GATEWAY_EXTENDED_ADDRESSING
        bool "29-bit identifiers (ISO 15765-4 extended): request on 0x18DB33F1"
        default n
        help
            For vehicles whose OBD port carries 29-bit identifiers. The request is functional
            (0x18DB33F1) and answers are taken only from 0x18DAF1xx with the address below.
            Overrides the functional-addressing option. Receive filter: everything is passed
            to the decoder, which discards what is not an OBD answer.

    config GATEWAY_EXTENDED_ECU_ADDRESS
        hex "Engine ECU source address in 0x18DAF1xx answers"
        depends on GATEWAY_EXTENDED_ADDRESSING
        default 0x10
        range 0x00 0xFF

    config GATEWAY_POLL_PERIOD_MS
        int "Poll cycle period (ms)"
        range 100 60000
        default 1000

    config GATEWAY_ERROR_GUARD_THRESHOLD
        int "Bus errors after which a vehicle build stops requesting"
        range 1 1000
        default 16
        help
            Counted from the start of polling. Well below the 96 errors at which a CAN
            controller turns error passive.

    menu "Publishing to the backend"

        config GATEWAY_WIFI_SSID
            string "WiFi SSID (empty: do not publish)"
            default ""
            help
                With an empty SSID the gateway only prints readings, as before. Credentials live
                in the git-ignored sdkconfig; never put them in sdkconfig.defaults.

        config GATEWAY_WIFI_PASSWORD
            string "WiFi password"
            default ""

        config GATEWAY_MQTT_URI
            string "MQTT broker URI"
            default "mqtt://192.168.1.10:1883"
            help
                The Mosquitto of the edge server, usually the laptop running Docker Compose, on
                the same WiFi network.

        config GATEWAY_DEVICE_ID
            string "Device id"
            default "gateway-01"
            help
                Printable ASCII, at most 64 characters, without '/', '+', '#' or '"'.

        config GATEWAY_VEHICLE_ID
            string "Vehicle id"
            default "bench-01"
            help
                Same rules as the device id.

        config GATEWAY_SNTP_SERVER
            string "SNTP server"
            default "pool.ntp.org"

        choice GATEWAY_DEFAULT_MODE
            prompt "Processing mode at start-up"
            default GATEWAY_DEFAULT_MODE_P2
            help
                Only the start value: a command on veh/{v}/dev/{d}/cmd/req switches the mode at
                runtime without a reflash.

            config GATEWAY_DEFAULT_MODE_P2
                bool "P2: decode on the gateway, publish readings"
            config GATEWAY_DEFAULT_MODE_P0
                bool "P0: publish raw answer frames, the backend decodes"
        endchoice

    endmenu

endmenu
```
